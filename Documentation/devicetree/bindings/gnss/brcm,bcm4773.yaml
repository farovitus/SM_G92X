## Documentation/devicetree/bindings/gnss/brcm,bcm4773.yaml
```yaml
# SPDX-License-Identifier: (GPL-2.0-only OR BSD-2-Clause)
%YAML 1.2
---
$id: http://devicetree.org/schemas/gnss/brcm,bcm4773.yaml#
$schema: http://devicetree.org/meta-schemas/core.yaml#

title: Broadcom BCM4773 GNSS receiver and sensor hub

maintainers:
  - FAROVITUS <farovitus@gmail.com>

description: |
  The BCM4773 is a GNSS receiver with a second core that runs a sensor
  hub: on the Samsung Galaxy S6 the accelerometer, gyroscope,
  magnetometer, barometer and light/proximity sensors hang off it. The
  host reaches it over SPI with Broadcom's SSI protocol. The chip has no
  flash; its RAM firmware is loaded at every power-up by userspace.

  SSI framing uses three lines besides SPI: mcu-req (host asks the chip to
  wake), mcu-resp (chip is awake) and host-req (chip has data, also the
  interrupt).

allOf:
  - $ref: /schemas/spi/spi-peripheral-props.yaml#

properties:
  compatible:
    const: brcm,bcm4773

  reg:
    maxItems: 1

  interrupts:
    maxItems: 1
    description: host-req, level high.

  spi-max-frequency: true
  spi-cpha: true
  spi-cpol: true

  enable-gpios:
    maxItems: 1
    description: Power line, pin NSTANDBY; asserted to run.

  host-req-gpios:
    maxItems: 1
    description: Chip has data for the host.

  mcu-req-gpios:
    maxItems: 1
    description: Host requests an SSI burst.

  mcu-resp-gpios:
    maxItems: 1
    description: Chip acknowledges mcu-req.

  sensorhub:
    type: object
    additionalProperties: false
    description: The sensor hub running on the chip.

    properties:
      compatible:
        const: samsung,zeroflte-sensorhub

      samsung,acc-position:
        $ref: /schemas/types.yaml#/definitions/uint32
        maximum: 7
        description: Mounting orientation index of the accelerometer and
          gyroscope, as the hub firmware numbers them.

      samsung,mag-position:
        $ref: /schemas/types.yaml#/definitions/uint32
        maximum: 7
        description: Mounting orientation index of the magnetometer.

      samsung,glass-type:
        $ref: /schemas/types.yaml#/definitions/uint32
        description: Cover glass variant, for the light sensor coefficients.

      samsung,prox-thresholds:
        $ref: /schemas/types.yaml#/definitions/uint32-array
        items:
          - description: high (near) threshold
          - description: low (far) threshold

      samsung,mag-matrix:
        $ref: /schemas/types.yaml#/definitions/int32-array
        minItems: 9
        maxItems: 9
        description: Magnetometer soft-iron matrix, row-major, as signed
          16-bit factory values.

    required:
      - compatible

required:
  - compatible
  - reg
  - interrupts
  - enable-gpios
  - host-req-gpios
  - mcu-req-gpios
  - mcu-resp-gpios

unevaluatedProperties: false

examples:
  - |
    #include <dt-bindings/gpio/gpio.h>
    #include <dt-bindings/interrupt-controller/irq.h>

    spi {
        #address-cells = <1>;
        #size-cells = <0>;

        gnss@0 {
            compatible = "brcm,bcm4773";
            reg = <0>;
            spi-max-frequency = <26000000>;
            spi-cpha;
            spi-cpol;
            interrupt-parent = <&gpa3>;
            interrupts = <6 IRQ_TYPE_LEVEL_HIGH>;
            enable-gpios = <&gpf4 7 GPIO_ACTIVE_HIGH>;
            host-req-gpios = <&gpa3 6 GPIO_ACTIVE_HIGH>;
            mcu-req-gpios = <&gpf4 5 GPIO_ACTIVE_HIGH>;
            mcu-resp-gpios = <&gpf4 4 GPIO_ACTIVE_HIGH>;

            sensorhub {
                compatible = "samsung,zeroflte-sensorhub";
                samsung,acc-position = <0>;
                samsung,mag-position = <0>;
                samsung,glass-type = <0>;
                samsung,prox-thresholds = <2000 1400>;
                samsung,mag-matrix = <10213 (-360) 154 (-206) 8673 (-59)
                                      (-66) (-59) 10479>;
            };
        };
    };
```

## Documentation/devicetree/bindings/media/samsung,exynos7420-fimc-lite.yaml
```yaml
# SPDX-License-Identifier: (GPL-2.0-only OR BSD-2-Clause)
%YAML 1.2
---
$id: http://devicetree.org/schemas/media/samsung,exynos7420-fimc-lite.yaml#
$schema: http://devicetree.org/meta-schemas/core.yaml#

title: Samsung Exynos7420 FIMC-LITE raw capture

maintainers:
  - FAROVITUS <farovitus@gmail.com>

description:
  The FIMC-LITE (FIMC-BNS) blocks of the Exynos7420 write the pixel stream
  of a MIPI CSIS receiver to memory. Each block has one input port linked
  to a CSIS output endpoint.

properties:
  compatible:
    const: samsung,exynos7420-fimc-lite

  reg:
    maxItems: 1

  interrupts:
    maxItems: 1

  clocks:
    minItems: 1
    maxItems: 6

  clock-names:
    minItems: 1
    maxItems: 6

  power-domains:
    maxItems: 1

  memory-region:
    maxItems: 1

  port:
    $ref: /schemas/graph.yaml#/properties/port
    description: Input port, linked to the CSIS output endpoint.

required:
  - compatible
  - reg
  - interrupts
  - clocks
  - power-domains
  - port

additionalProperties: false

examples:
  - |
    #include <dt-bindings/clock/exynos7-clk.h>
    #include <dt-bindings/interrupt-controller/arm-gic.h>

    fimc-lite@14030000 {
        compatible = "samsung,exynos7420-fimc-lite";
        reg = <0x14030000 0x1000>;
        interrupts = <GIC_SPI 134 IRQ_TYPE_LEVEL_HIGH>;
        clocks = <&clock_cam0 CLK_ACLK_FIMC_BNS_B>,
                 <&clock_cam0 CLK_PCLK_FIMC_BNS_B>;
        clock-names = "aclk", "pclk";
        power-domains = <&pd_cam0>;

        port {
            fimc_lite_b_in: endpoint {
                remote-endpoint = <&csis1_out>;
            };
        };
    };
...
```

## Documentation/devicetree/bindings/spi/samsung,exynos-spi-gpio.yaml
```yaml
# SPDX-License-Identifier: (GPL-2.0-only OR BSD-2-Clause)
%YAML 1.2
---
$id: http://devicetree.org/schemas/spi/samsung,exynos-spi-gpio.yaml#
$schema: http://devicetree.org/meta-schemas/core.yaml#

title: Bit-banged SPI on a Samsung GPIO bank

maintainers:
  - FAROVITUS <farovitus@gmail.com>

description:
  An SPI host bit-banged on GPIO lines of a Samsung/Exynos pin bank, for
  boards whose SPI controller cannot be used. SCK, MOSI and MISO must be
  lines of the same bank; the host writes that bank's data register once
  per clock edge. Chip selects are GPIOs and may be on any bank.

allOf:
  - $ref: /schemas/spi/spi-controller.yaml#

properties:
  compatible:
    const: samsung,exynos-spi-gpio

  sck-gpios:
    maxItems: 1

  mosi-gpios:
    maxItems: 1

  miso-gpios:
    maxItems: 1

  cs-gpios:
    minItems: 1

required:
  - compatible
  - sck-gpios
  - mosi-gpios
  - miso-gpios
  - cs-gpios

unevaluatedProperties: false

examples:
  - |
    #include <dt-bindings/gpio/gpio.h>

    spi {
        compatible = "samsung,exynos-spi-gpio";
        #address-cells = <1>;
        #size-cells = <0>;
        sck-gpios = <&gpd6 2 GPIO_ACTIVE_HIGH>;
        miso-gpios = <&gpd6 4 GPIO_ACTIVE_HIGH>;
        mosi-gpios = <&gpd6 5 GPIO_ACTIVE_HIGH>;
        cs-gpios = <&gpd6 3 GPIO_ACTIVE_LOW>;
    };
...
```

## drivers/gud/Kconfig
```kconfig
# SPDX-License-Identifier: GPL-2.0-only

config TRUSTONIC_MOBICORE
	tristate "Trustonic t-base (MobiCore) normal-world driver"
	depends on ARM64 && OF
	help
	  Driver for the Trustonic t-base 302A secure OS on Exynos 7420.
	  It provides /dev/mobicore and /dev/mobicore-user for McDaemon,
	  which Samsung's keymaster and gatekeeper HALs depend on.
```

## drivers/iio/common/ssp_sensors/Kconfig
```kconfig
# SPDX-License-Identifier: GPL-2.0-only
#
# SSP sensor drivers and commons configuration
#
menu "SSP Sensor Common"

config IIO_SSP_SENSORS_COMMONS
	tristate "Commons for all SSP Sensor IIO drivers"
	depends on IIO_SSP_SENSORHUB
	select IIO_BUFFER
	select IIO_KFIFO_BUF
	help
	  Say yes here to build commons for SSP sensors.
	  To compile this as a module, choose M here: the module
	  will be called ssp_iio.

config IIO_SSP_SENSORHUB
	tristate "Samsung Sensorhub driver"
	depends on SPI
	select MFD_CORE
	help
	  SSP driver for sensorhub.
	  If you say yes here you get ssp support for sensorhub.
	  To compile this driver as a module, choose M here: the
	  module will be called sensorhub.

config IIO_SSP_SENSORHUB_BCM4773
	bool "Sensorhub behind a Broadcom BCM4773 (Galaxy S6)"
	depends on IIO_SSP_SENSORHUB && OF
	depends on BCM4773=y || BCM4773=IIO_SSP_SENSORHUB
	help
	  Say yes here for the Galaxy S6 and S6 edge, whose sensor hub
	  firmware runs on the BCM4773 GNSS chip and talks to the AP through
	  the BCM4773 bridge. The hub starts once userspace (lhd) has loaded
	  the chip's firmware.

config IIO_SSP_HUB_SENSORS
	tristate "SSP magnetometer, pressure, light, proximity and motion sensors"
	depends on IIO_SSP_SENSORHUB
	select IIO_BUFFER
	select IIO_KFIFO_BUF
	help
	  Say yes here for IIO devices of the sensorhub's magnetometer,
	  pressure, light and proximity sensors, rotation vectors, step
	  counter, step detector and significant motion.
	  To compile this as a module, choose M here: the module
	  will be called ssp_hub_sensors.

endmenu
```

## drivers/media/platform/samsung/exynos7-flite/Kconfig
```kconfig
# SPDX-License-Identifier: GPL-2.0-only

config VIDEO_EXYNOS7_FLITE
	tristate "Samsung Exynos7420 FIMC-LITE raw capture"
	depends on V4L_PLATFORM_DRIVERS
	depends on VIDEO_DEV
	depends on ARCH_EXYNOS || COMPILE_TEST
	depends on OF
	select MEDIA_CONTROLLER
	select V4L2_FWNODE
	select VIDEO_V4L2_SUBDEV_API
	select VIDEOBUF2_DMA_CONTIG
	help
	  Video4Linux2 capture driver for the FIMC-LITE (FIMC-BNS) blocks
	  of the Exynos7420 SoC. It writes the raw Bayer stream of a MIPI
	  CSIS receiver to memory.

	  To compile this driver as a module, choose M here: the module
	  will be called exynos7-flite.
```

## drivers/memory/samsung/Kconfig
```kconfig
# SPDX-License-Identifier: GPL-2.0
config SAMSUNG_MC
	bool "Samsung Exynos Memory Controller support" if COMPILE_TEST
	help
	  Support for the Memory Controller (MC) devices found on
	  Samsung Exynos SoCs.

config EXYNOS7420_DMC
	bool "Exynos7420 DRAM controller frequency switching"
	depends on ARCH_EXYNOS || COMPILE_TEST
	depends on COMMON_CLK_SAMSUNG && DEBUG_FS
	select SAMSUNG_MC
	help
	  Switches the Exynos7420 DRAM clock (MIF) between the stock
	  levels, reprogramming the DREX timings, the LPDDR4 PHY and the
	  DRAM mode registers through the BUS0 safe PLL as the stock
	  kernel did. The 7420 has no firmware call for this.

if SAMSUNG_MC

config EXYNOS5422_DMC
	tristate "Exynos5422 Dynamic Memory Controller driver"
	depends on ARCH_EXYNOS || (COMPILE_TEST && HAS_IOMEM)
	select DDR
	depends on DEVFREQ_GOV_SIMPLE_ONDEMAND
	depends on (PM_DEVFREQ && PM_DEVFREQ_EVENT)
	help
	  This adds driver for Samsung Exynos5422 SoC DMC (Dynamic Memory
	  Controller).  The driver provides support for Dynamic Voltage and
	  Frequency Scaling in DMC and DRAM. It also supports changing timings
	  of DRAM running with different frequency. The timings are calculated
	  based on DT memory information.
	  If unsure, say Y on devices with Samsung Exynos SoCs.

config EXYNOS_SROM
	bool "Exynos SROM controller driver" if COMPILE_TEST
	depends on (ARM && ARCH_EXYNOS) || (COMPILE_TEST && HAS_IOMEM)
	help
	  This adds driver for Samsung Exynos SoC SROM controller.  The driver
	  in basic operation mode only saves and restores SROM registers
	  during suspend.  If however appropriate device tree configuration
	  is provided, the driver enables support for external memory
	  or external devices.
	  If unsure, say Y on devices with Samsung Exynos SoCs.

endif
```

## drivers/misc/bcm4773/Kconfig
```kconfig
# SPDX-License-Identifier: GPL-2.0-only
config BCM4773
	tristate "Broadcom BCM4773 GNSS and sensor hub bridge"
	depends on SPI && OF
	depends on GPIOLIB
	help
	  Bridge driver for the Broadcom BCM4773 GNSS chip, which also carries
	  the sensor hub of the Samsung Galaxy S6. The chip is reached over
	  Broadcom's SSI protocol on SPI. Broadcom's lhd daemon loads the
	  chip's RAM firmware and drives GNSS through /dev/bbd_*; the sensor
	  hub driver talks to the hub through this bridge.

	  To compile this driver as a module, choose M here: the module will
	  be called bcm4773.
```

## drivers/misc/mipi-lli/Kconfig
```kconfig
# SPDX-License-Identifier: GPL-2.0-only
config MIPI_LLI
	bool "Exynos7420 MIPI-LLI modem link"
	depends on ARCH_EXYNOS || COMPILE_TEST
	depends on OF && OF_RESERVED_MEM
	select MFD_SYSCON
	select REGMAP_MMIO
	help
	  MIPI Low Latency Interface host controller and combo M-PHY of the
	  Exynos7420. It maps the CP's IPC memory into the AP-side LLI window
	  and carries the sideband signals between AP and CP. Used by the
	  SS333 modem driver on the Galaxy S6 (SM-G920F/SM-G925F).
```

## drivers/misc/modem_v1/Kconfig
```kconfig
# SPDX-License-Identifier: GPL-2.0-only
config SEC_MODEM_SS333
	bool "Samsung SS333 (Shannon 333) modem interface"
	depends on MIPI_LLI && SPI_MASTER && NET
	help
	  Modem interface for the Shannon 333 CP on the Galaxy S6
	  (SM-G920F/SM-G925F): CP power and reset GPIOs, the SPI bootloader
	  link, the MIPI-LLI shared-memory IPC link with link power
	  management, and the stock character devices (/dev/umts_*) and
	  rmnet network interfaces that cbd and the RIL expect.

	  The platform driver keeps the stock name "mif_sipc5".
```

## drivers/thermal/samsung/Kconfig
```kconfig
# SPDX-License-Identifier: GPL-2.0-only
config EXYNOS_THERMAL
	tristate "Exynos thermal management unit driver"
	depends on THERMAL_OF
	depends on HAS_IOMEM
	help
	  If you say yes here you get support for the TMU (Thermal Management
	  Unit) driver for Samsung Exynos series of SoCs. This driver initialises
	  the TMU, reports temperature and handles cooling action if defined.
	  This driver uses the Exynos core thermal APIs and TMU configuration
	  data from the supported SoCs.

config SEC_COOLING_COMPAT
	tristate "Placeholder cooling devices for Samsung's Android thermal HAL"
	depends on OF
	help
	  Registers inert "thermal-cpufreq-0", "thermal-cpufreq-1" and
	  "battery" cooling devices, the 3.10 names Samsung's thermal HAL
	  requires. They have one state and throttle nothing.
```
